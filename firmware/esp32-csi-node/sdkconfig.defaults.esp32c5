## firmware/esp32-csi-node/sdkconfig.defaults.esp32c5
```kconfig
# ESP32-C5 CSI baseline. Requires ESP-IDF >= 5.5.2.
# Auto-loaded after sdkconfig.defaults when IDF_TARGET=esp32c5.
# Conservative 4 MB layout; no assumption about external PSRAM or LED wiring.
CONFIG_IDF_TARGET="esp32c5"
CONFIG_PARTITION_TABLE_CUSTOM=y
CONFIG_PARTITION_TABLE_CUSTOM_FILENAME="partitions_4mb.csv"
CONFIG_ESPTOOLPY_FLASHSIZE_4MB=y
CONFIG_ESPTOOLPY_FLASHSIZE="4MB"
CONFIG_ESP_CONSOLE_UART_DEFAULT=y
# CONFIG_ESP_CONSOLE_USB_SERIAL_JTAG is not set
# CONFIG_ESP_CONSOLE_SECONDARY_USB_SERIAL_JTAG is not set
CONFIG_ESP_WIFI_CSI_ENABLED=y
CONFIG_ESP_WIFI_ENABLE_WPA3_SAE=y
CONFIG_ESP_DEFAULT_CPU_FREQ_MHZ_240=y
CONFIG_ESP_DEFAULT_CPU_FREQ_MHZ=240
CONFIG_EDGE_DSP_SAMPLE_HZ=8
CONFIG_C5_STATUS_LED_GPIO=-1
# CONFIG_DISPLAY_ENABLE is not set
# CONFIG_WASM_ENABLE is not set
CONFIG_COMPILER_OPTIMIZATION_SIZE=y
CONFIG_BOOTLOADER_LOG_LEVEL_WARN=y
CONFIG_LOG_DEFAULT_LEVEL_INFO=y
CONFIG_ESP_MAIN_TASK_STACK_SIZE=8192
CONFIG_FREERTOS_TIMER_TASK_STACK_DEPTH=8192
```
