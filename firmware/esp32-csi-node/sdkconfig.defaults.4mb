## firmware/esp32-csi-node/sdkconfig.defaults.4mb
```kconfig
# ESP32-S3 CSI Node — 4MB Flash SDK Configuration (issue #265)
# For boards with 4MB flash (e.g. ESP32-S3 SuperMini 4MB).
#
# Build: cp sdkconfig.defaults.4mb sdkconfig.defaults && idf.py set-target esp32s3 && idf.py build
# Or:    idf.py -D SDKCONFIG_DEFAULTS="sdkconfig.defaults.4mb" set-target esp32s3 && idf.py build

CONFIG_IDF_TARGET="esp32s3"

# 4MB flash partition table
CONFIG_PARTITION_TABLE_CUSTOM=y
CONFIG_PARTITION_TABLE_CUSTOM_FILENAME="partitions_4mb.csv"
CONFIG_ESPTOOLPY_FLASHSIZE_4MB=y
CONFIG_ESPTOOLPY_FLASHSIZE="4MB"

# Compiler: optimize for size (critical for 4MB)
CONFIG_COMPILER_OPTIMIZATION_SIZE=y

# CSI support
CONFIG_ESP_WIFI_CSI_ENABLED=y

# Disable display support to save flash (ADR-045 display requires 8MB)
# CONFIG_DISPLAY_ENABLE is not set

# Reduce logging to save flash
CONFIG_BOOTLOADER_LOG_LEVEL_WARN=y
CONFIG_LOG_DEFAULT_LEVEL_INFO=y

CONFIG_LWIP_SO_RCVBUF=y
CONFIG_ESP_MAIN_TASK_STACK_SIZE=8192

# ADR-081: adaptive_controller runs emit_feature_state + stream_sender
# network I/O inside Timer Svc callbacks, exceeding the 2 KiB default.
CONFIG_FREERTOS_TIMER_TASK_STACK_DEPTH=8192
```

## firmware/esp32-csi-node/sdkconfig.defaults.esp32c3
```kconfig
# Target: ESP32-C3
CONFIG_IDF_TARGET="esp32c3"

# Partition table for 4MB flash
CONFIG_PARTITION_TABLE_CUSTOM=y
CONFIG_PARTITION_TABLE_CUSTOM_FILENAME="partitions_4mb.csv"
CONFIG_ESPTOOLPY_FLASHSIZE_4MB=y
CONFIG_ESPTOOLPY_FLASHSIZE="4MB"

# Disable Display (no GPIOs/PSRAM for it on Super Mini)
CONFIG_DISPLAY_ENABLE=n

# Disable WASM (too heavy for C3 internal RAM)
CONFIG_WASM_ENABLE=n

# RISC-V specific
CONFIG_ESP32C3_REV_MIN_3=y

# Memory optimization
CONFIG_COMPILER_OPTIMIZATION_SIZE=y
CONFIG_LWIP_IRAM_OPTIMIZATION=n
CONFIG_WIFI_LWIP_ALLOCATION_FROM_SPIRAM=n
```

## firmware/esp32-csi-node/sdkconfig.defaults.esp32c6
```kconfig
# Target: ESP32-C6
CONFIG_IDF_TARGET="esp32c6"

# Partition table for 4MB flash (M5NanoC6 has 4MB)
CONFIG_PARTITION_TABLE_CUSTOM=y
CONFIG_PARTITION_TABLE_CUSTOM_FILENAME="partitions_4mb.csv"
CONFIG_ESPTOOLPY_FLASHSIZE_4MB=y
CONFIG_ESPTOOLPY_FLASHSIZE="4MB"

# Disable Display
CONFIG_DISPLAY_ENABLE=n

# WASM can be enabled on C6 as it has more SRAM (512KB),
# but we'll keep it disabled by default for maximum stability.
CONFIG_WASM_ENABLE=n

# RISC-V specific
CONFIG_COMPILER_OPTIMIZATION_SIZE=y
```

## firmware/esp32-csi-node/sdkconfig.defaults.esp32s3
```kconfig
# ESP32-S3 CSI Node — Default SDK Configuration
# This file is applied automatically by idf.py when no sdkconfig exists.

# Target: ESP32-S3
CONFIG_IDF_TARGET="esp32s3"

# Use custom partition table (8MB flash with OTA — ADR-045)
CONFIG_PARTITION_TABLE_CUSTOM=y
CONFIG_PARTITION_TABLE_CUSTOM_FILENAME="partitions_display.csv"

# Flash configuration: 8MB (Quad SPI)
CONFIG_ESPTOOLPY_FLASHSIZE_8MB=y
CONFIG_ESPTOOLPY_FLASHSIZE="8MB"

# Compiler optimization: optimize for size to reduce binary
CONFIG_COMPILER_OPTIMIZATION_SIZE=y

# Enable CSI (Channel State Information) in WiFi driver
CONFIG_ESP_WIFI_CSI_ENABLED=y

# Disable NVS encryption (enabling this requires complex provision-time key management)
CONFIG_NVS_ENCRYPTION=n

# Disable unused features to reduce binary size
CONFIG_BOOTLOADER_LOG_LEVEL_WARN=y
CONFIG_LOG_DEFAULT_LEVEL_INFO=y

# LWIP: enable extended socket options for UDP multicast
CONFIG_LWIP_SO_RCVBUF=y

# FreeRTOS: increase task stack for CSI processing
CONFIG_ESP_MAIN_TASK_STACK_SIZE=8192
```

## firmware/esp32-hello-world/sdkconfig.defaults
```kconfig
# ESP32-S3 Hello World — SDK Configuration
CONFIG_IDF_TARGET="esp32s3"

# Flash: 4MB (this chip has Embedded Flash 4MB)
CONFIG_ESPTOOLPY_FLASHSIZE_4MB=y
CONFIG_ESPTOOLPY_FLASHSIZE="4MB"

# Enable WiFi CSI so we can probe it
CONFIG_ESP_WIFI_CSI_ENABLED=y

# Verbose logging so user sees everything
CONFIG_LOG_DEFAULT_LEVEL_INFO=y

# Bigger main task stack for printf-heavy capability dump
CONFIG_ESP_MAIN_TASK_STACK_SIZE=8192

# Enable temperature sensor driver
CONFIG_SOC_TEMP_SENSOR_SUPPORTED=y
```
